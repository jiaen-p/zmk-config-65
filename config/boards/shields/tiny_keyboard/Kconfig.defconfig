## config/boards/shields/tiny_keyboard/Kconfig.defconfig
```kconfig
if SHIELD_TINY_KEYBOARD

config ZMK_KEYBOARD_NAME
    default "Tiny Keyboard"

endif
```

## config/boards/shields/tiny_keyboard/Kconfig.shield
```kconfig
config SHIELD_TINY_KEYBOARD
    def_bool $(shields_list_contains, tiny_keyboard)
```
